## board/amlogic/axg_jethubj100_v1/Kconfig
```kconfig
if TARGET_JETHUBJ100_V1

config SYS_SOC
	default "axg"

config SYS_BOARD
	default "axg_jethubj100_v1"

config SYS_VENDOR
	default "amlogic"

config SYS_CONFIG_NAME
	default "axg_jethubj100_v1"

config DTB_BIND_KERNEL
    bool "load dtb from boot part but not flash rsv"
    default n

endif
```

## board/amlogic/gxl_jethubj80_v1/Kconfig
```kconfig
if TARGET_JETHUBJ80_V1

config SYS_SOC
	default "gxl"

config SYS_BOARD
	default "gxl_jethubj80_v1"

config SYS_VENDOR
	default "amlogic"

config SYS_CONFIG_NAME
	default "gxl_jethubj80_v1"

endif
```

## configs/axg_jethubj100_v1_defconfig
```kconfig
CONFIG_ARM=y
CONFIG_SYS_BOARD="axg_jethubj100_v1"
CONFIG_SYS_CONFIG_NAME="axg_jethubj100_v1"
CONFIG_ARCH_MESON=y
CONFIG_SYS_TEXT_BASE=0x01000000
CONFIG_NR_DRAM_BANKS=1
CONFIG_ENV_SIZE=0x2000
CONFIG_DM_GPIO=y
CONFIG_MESON_AXG=y
CONFIG_DEBUG_UART_BASE=0xff803000
CONFIG_DEBUG_UART_CLOCK=24000000
CONFIG_IDENT_STRING=" axg_jethubj100_v1"
CONFIG_DEFAULT_DEVICE_TREE="meson-axg-jethub-j100"
CONFIG_DEBUG_UART=y
CONFIG_OF_BOARD_SETUP=y
# CONFIG_DISPLAY_CPUINFO is not set
CONFIG_MISC_INIT_R=y
CONFIG_MISC=y
# CONFIG_CMD_BDI is not set
# CONFIG_CMD_IMI is not set
CONFIG_CMD_GPIO=y
# CONFIG_CMD_LOADS is not set
CONFIG_CMD_MMC=y
CONFIG_CMD_USB=y
CONFIG_CMD_USB_MASS_STORAGE=y
CONFIG_CMD_SETEXPR=y
CONFIG_CMD_REGULATOR=y
CONFIG_OF_CONTROL=y
CONFIG_SYS_RELOC_GD_ENV_ADDR=y
CONFIG_NET_RANDOM_ETHADDR=y
CONFIG_ADC=y
CONFIG_SARADC_MESON=y
CONFIG_DM_MMC=y
CONFIG_MMC_MESON_GX=y
CONFIG_PHY_REALTEK=y
CONFIG_DM_ETH=y
CONFIG_ETH_DESIGNWARE=y
CONFIG_MESON_AXG_USB_PHY=y
CONFIG_PINCTRL=y
CONFIG_PINCTRL_MESON_AXG=y
CONFIG_POWER_DOMAIN=y
CONFIG_MESON_EE_POWER_DOMAIN=y
CONFIG_DM_REGULATOR=y
CONFIG_DM_REGULATOR_FIXED=y
CONFIG_DM_RESET=y
CONFIG_DEBUG_UART_ANNOUNCE=y
CONFIG_DEBUG_UART_SKIP_INIT=y
CONFIG_MESON_SERIAL=y
CONFIG_USB=y

CONFIG_DM_USB=y

CONFIG_USB_GADGET=y
#CONFIG_USB_GADGET_VENDOR_NUM=0x1b8e
#CONFIG_USB_GADGET_PRODUCT_NUM=0xfada
CONFIG_USB_GADGET_VENDOR_NUM=0x1b8e
CONFIG_USB_GADGET_PRODUCT_NUM=0xc004
CONFIG_USB_GADGET_MANUFACTURER  "Amlogic Inc"
USB_GADGET_OS_DESCRIPTORS=y

CONFIG_DM_USB_GADGET=y
CONFIG_USB_DWC3_GADGET=y
#CONFIG_USB_DWC3_MESON_GXL=y
CONFIG_USB_XHCI_HCD=y
CONFIG_USB_XHCI_DWC3=y
CONFIG_USB_DWC3=y
CONFIG_USB_DWC3_GADGET=y
CONFIG_USB_DWC3_MESON_AXG=y
CONFIG_USB_KEYBOARD=y

CONFIG_USB_GADGET_DWC2_OTG=y
CONFIG_USB_GADGET_DOWNLOAD=y

CONFIG_OF_LIBFDT_OVERLAY=y

# ADD from uboot 2015.04
CONFIG_AML_CRYPTO_UBOOT=y
CONFIG_AML_FACTORY_BURN_LOCAL_UPGRADE=y
CONFIG_USB_XHCI=y
CONFIG_USB_XHCI_AMLOGIC_GXL=y
CONFIG_AML_PARTITION=y
CONFIG_AML_SECURE_UBOOT=y
CONFIG_AML_SECURITY_KEY=y

CONFIG_DDR_CLK=912
CONFIG_DDR4_CLK=912
CONFIG_CMD_I2C=y
CONFIG_DM_I2C=y
CONFIG_SYS_I2C_MESON=y

#CONFIG_MTD_DEVICE=y
CONFIG_CMD_MD5SUM=y
CONFIG_MD5=y
CONFIG_SHA1=y

# add from v2015-amlogic                                                                                                                                                                   
CONFIG_USB_GADGET=y                                                                                                                                                                        
CONFIG_AML_V2_FACTORY_BURN=y                                                                                                                                                               
CONFIG_POWER_KEY_NOT_SUPPORTED_FOR_BURN=y                                                                                                                                                  
CONFIG_AML_STORAGE=y                                                                                                                                                                       
CONFIG_CMD_DSPRUN=n                                                                                                                                                                        
CONFIG_CMD_DSPSET=n                                                                                                                                                                        
CONFIG_AML_STORE_WRAPPER=y                                                                                                                                                                 
CONFIG_AML_DRIVER=y                                                                                                                                                                        
CONFIG_SHA1=y                                                                                                                                                                              
CONFIG_MTD_UBI=y                                                                                                                                                                           
CONFIG_MTD=y                                                                                                                                                                               
CONFIG_EFUSE=n                                                                                                                                                                             
CONFIG_CMD_EFUSE=n                                                                                                                                                                         

CONFIG_AML_V2_FACTORY_BURN=y
CONFIG_AML_FACTORY_BURN_LOCAL_UPGRADE=yes
#CONFIG_USB_BURNING_TOOL=y
#no screen CONFIG_SD_BURNING_SUPPORT_UI=y
CONFIG_SYS_SOC="axg"
CONFIG_TARGET_JETHUBJ100_V1=y


CONFIG_USB_XHCI_HCD=y
CONFIG_USB_XHCI_DWC3=y
CONFIG_USB_DWC3=y
# CONFIG_USB_DWC3_GADGET is not set
#CONFIG_USB_DWC3_MESON_GXL=y
CONFIG_USB_GADGET=y
CONFIG_USB_GADGET_VENDOR_NUM=0x1b8e
CONFIG_USB_GADGET_PRODUCT_NUM=0xfada
CONFIG_USB_GADGET_DWC2_OTG=y
CONFIG_USB_GADGET_DOWNLOAD=y
CONFIG_PHY_MESON_GXL=y
CONFIG_PHY=y
```

## configs/gxl_jethubj80_v1_defconfig
```kconfig
CONFIG_ARM=y
CONFIG_ARCH_MESON=y
CONFIG_SYS_TEXT_BASE=0x01000000
CONFIG_NR_DRAM_BANKS=1
CONFIG_ENV_SIZE=0x2000
CONFIG_DM_GPIO=y
CONFIG_MESON_GXL=y
CONFIG_SYS_BOARD="gxl_jethubj80_v1"
CONFIG_SYS_CONFIG_NAME="gxl_jethubj80_v1"
CONFIG_SYS_SOC="gxl"
CONFIG_DEBUG_UART_BASE=0xc81004c0
CONFIG_DEBUG_UART_CLOCK=24000000
CONFIG_IDENT_STRING=" jethubj80_v1"
CONFIG_DEFAULT_DEVICE_TREE="meson-gxl-s905w-jethome-jethub-j80"
CONFIG_DEBUG_UART=y
CONFIG_OF_BOARD_SETUP=y
CONFIG_CONSOLE_MUX=y
# CONFIG_DISPLAY_CPUINFO is not set
CONFIG_MISC_INIT_R=y
# CONFIG_CMD_BDI is not set
# CONFIG_CMD_IMI is not set
CONFIG_CMD_GPIO=y
# CONFIG_CMD_LOADS is not set
CONFIG_CMD_MMC=y
CONFIG_CMD_USB=y
CONFIG_CMD_SETEXPR=y
CONFIG_CMD_REGULATOR=y
CONFIG_OF_CONTROL=y
CONFIG_SYS_RELOC_GD_ENV_ADDR=y
CONFIG_NET_RANDOM_ETHADDR=y
CONFIG_DM_MMC=y
CONFIG_MMC_MESON_GX=y
CONFIG_PHY_ADDR_ENABLE=y
CONFIG_PHY_ADDR=8
CONFIG_PHY_MESON_GXL=y
CONFIG_DM_ETH=y
CONFIG_ETH_DESIGNWARE=y
CONFIG_MESON_GXL_USB_PHY=y
CONFIG_PINCTRL=y
CONFIG_PINCTRL_MESON_GXL=y
CONFIG_DM_REGULATOR=y
CONFIG_DM_REGULATOR_FIXED=y
CONFIG_DM_RESET=y
CONFIG_DEBUG_UART_ANNOUNCE=y
CONFIG_DEBUG_UART_SKIP_INIT=y
CONFIG_MESON_SERIAL=y
CONFIG_USB=y
CONFIG_DM_USB=y
CONFIG_USB_XHCI_HCD=y
CONFIG_USB_XHCI_DWC3=y
CONFIG_USB_DWC3=y
CONFIG_USB_DWC3_MESON_GXL=y
CONFIG_OF_LIBFDT_OVERLAY=y
CONFIG_DM_MDIO=y
CONFIG_DM_MDIO_MUX=y
CONFIG_ETH_DESIGNWARE_MESON8B=y
CONFIG_MDIO_MUX_MMIOREG=y

# add from v2015-amlogic
CONFIG_USB_GADGET=y
CONFIG_AML_V2_FACTORY_BURN=y
CONFIG_POWER_KEY_NOT_SUPPORTED_FOR_BURN=y
CONFIG_AML_STORAGE=y
CONFIG_CMD_DSPRUN=n
CONFIG_CMD_DSPSET=n
CONFIG_AML_STORE_WRAPPER=y
CONFIG_AML_DRIVER=y
CONFIG_SHA1=y
CONFIG_MTD_UBI=y
CONFIG_MTD=y
CONFIG_EFUSE=n
CONFIG_CMD_EFUSE=n

CONFIG_AML_V2_FACTORY_BURN=y
CONFIG_AML_FACTORY_BURN_LOCAL_UPGRADE=yes
#CONFIG_USB_BURNING_TOOL=y
CONFIG_SD_BURNING_SUPPORT_UI=y
CONFIG_AML_PARTITION=y
CONFIG_TARGET_JETHUBJ80_V1=y
```
